#include "mySsd1306.h"
#include "myAdcWater.h"
#include "myFlame.h"
#include "myUart.h"
#include "i2c.h"
#include "stm32f4xx_hal.h"
#include "stm32f4xx_hal_i2c.h"
#include <stdint.h>

extern dht11Data_t dht_data;
static ds1302Time_t rtc_time = {0};


static uint8_t ssd1306_buffer[SSD1306_WIDTH * SSD1306_HEIGHT / 8];
/* 6x8 Basic ASCII Font Table (ASCII 0x20 ' ' to 0x7E '~') */
static const uint8_t font6x8[][6] = {
  { 0x00, 0x00, 0x00, 0x00, 0x00, 0x00 }, // ' '
  { 0x00, 0x00, 0x5F, 0x00, 0x00, 0x00 }, // '!'
  { 0x00, 0x07, 0x00, 0x07, 0x00, 0x00 }, // '"'
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  { 0x08, 0x08, 0x2A, 0x1C, 0x08, 0x00 }  // '~'
};

static void writeCommand(uint8_t cmd) {
    HAL_I2C_Mem_Write(&hi2c1, SSD1306_I2C_ADDR, 0x00, 1, &cmd, 1, 10);
}

void ssd1306Clear(void) {
    memset(ssd1306_buffer, 0x00, sizeof(ssd1306_buffer));
}

void ssd1306Update(void) {
    writeCommand(0x21); // set column address
    writeCommand(0);
    writeCommand(SSD1306_WIDTH - 1 );

    writeCommand(0x22); // set page address
    writeCommand(0);
    writeCommand((SSD1306_HEIGHT / 8) - 1);

    HAL_I2C_Mem_Write(&hi2c1, SSD1306_I2C_ADDR, 0x40, 1, ssd1306_buffer, sizeof(ssd1306_buffer), 100);
}


bool ssd1306Init(void)
{
  // 디바이스 응답 확인
  if (HAL_I2C_IsDeviceReady(&hi2c1, SSD1306_I2C_ADDR, 2, 10) != HAL_OK)
  {
    return false;
  }

  HAL_Delay(10);

  // SSD1306 초기화 시퀀스
  writeCommand(0xAE); // Display OFF

  writeCommand(0x20); // Set Memory Addressing Mode
  writeCommand(0x00); // 00: Horizontal Addressing Mode

  writeCommand(0xB0); // Set Page Start Address for Page Addressing Mode,0-7

  writeCommand(0xC8); // Set COM Output Scan Direction (Reversed)
  writeCommand(0x00); // Set low column address
  writeCommand(0x10); // Set high column address

  writeCommand(0x40); // Set start line address

  writeCommand(0x81); // Set contrast control register
  writeCommand(0xFF);

  writeCommand(0xA1); // Set Segment Re-map (0 to 127)

  writeCommand(0xA6); // Set Normal display (0xA7: Inverse)

  writeCommand(0xA8); // Set multiplex ratio(1 to 64)
  writeCommand(0x3F); // 1/64 duty

  writeCommand(0xA4); // 0xA4: Output follows RAM content; 0xA5: Entire display ON

  writeCommand(0xD3); // Set display offset
  writeCommand(0x00); // Not offset

  writeCommand(0xD5); // Set display clock divide ratio/oscillator frequency
  writeCommand(0xF0); // Set divide ratio

  writeCommand(0xD9); // Set pre-charge period
  writeCommand(0x22);

  writeCommand(0xDA); // Set com pins hardware configuration
  writeCommand(0x12);

  writeCommand(0xDB); // Set vcomh
  writeCommand(0x20); // 0x20: 0.77xVcc

  writeCommand(0x8D); // Set DC-DC enable
  writeCommand(0x14); // Enable charge pump

  writeCommand(0xAF); // Display ON
  
  ssd1306Clear();
  ssd1306Update();
  
  return true;
}


void ssd1306DrawPixel(int16_t x, int16_t y, uint8_t color) {
    if ( x < 0 || x >= SSD1306_WIDTH || y < 0 || y >= SSD1306_HEIGHT) {
        return;
    }

    if(color == SSD1306_COLOR_WHITE) {
        ssd1306_buffer[x + (y / 8) * SSD1306_WIDTH] |= (1<<(y%8));
    }
    else {
        ssd1306_buffer[x + (y / 8) * SSD1306_WIDTH] &= ~(1<<(y%8));
    }
}

void ssd1306DrawLine(int16_t x0, int16_t y0, int16_t x1, int16_t y1, uint8_t color)
{
  int16_t dx = abs(x1 - x0);
  int16_t sx = x0 < x1 ? 1 : -1;
  int16_t dy = -abs(y1 - y0);
  int16_t sy = y0 < y1 ? 1 : -1;
  int16_t err = dx + dy;
  int16_t e2;

  while (1)
  {
    ssd1306DrawPixel(x0, y0, color);
    if (x0 == x1 && y0 == y1)
      break;
    e2 = 2 * err;
    if (e2 >= dy)
    {
      err += dy;
      x0 += sx;
    }
    if (e2 <= dx)
    {
      err += dx;
      y0 += sy;
    }
  }
}

void ssd1306DrawRect(int16_t x, int16_t y, int16_t w, int16_t h, uint8_t color) {
    ssd1306DrawLine(x, y, x+w-1, y, color);
    ssd1306DrawLine(x, y+h-1, x+w-1, y+h-1,color);
    ssd1306DrawLine(x, y, x, y+h-1, color);
    ssd1306DrawLine(x+w-1, y, x+w-1, y+h-1, color);
}

void ssd1306FillRect(int16_t x, int16_t y, int16_t w, int16_t h, uint8_t color) {
    for (uint16_t i = x; i < x+w; i++) {
        for (uint16_t j = y; j < y+h; j++) {
            ssd1306DrawPixel(i, j, color);
        }
    }
}

void ssd1306DrawChar(int16_t x, int16_t y, char ch, uint8_t color) {
    if(ch<' ' || ch > '~') {
        return;
    }
    uint8_t index = ch - ' ';
    for (uint8_t i = 0; i < 6; i++) {
        uint8_t line = font6x8[index][i];
        for (uint8_t j = 0; j < 8; j++) {
            if (line & (1<<j)) {
                ssd1306DrawPixel(x+i, y+j, color);
            }
            else {
                ssd1306DrawPixel(x+i, y+j, !color);
            }
        }
    }
}

void ssd1306DrawString(int16_t x, int16_t y, const char *str, uint8_t color) {
    while(*str) {
        ssd1306DrawChar(x, y, *str, color);
        x += 6;
        str++;
    }
}

void ssd1306Printf(int16_t x, int16_t y, uint8_t color, const char *fmt, ...) {
    char buf[64];
    va_list args;
    va_start(args, fmt);
    vsnprintf(buf, sizeof(buf), fmt, args);
    va_end(args);
    ssd1306DrawString(x,y, buf, color);
}

// 큰글자 함수
void ssd1306DrawCharScale(int16_t x, int16_t y,
                          char ch,
                          uint8_t color,
                          uint8_t scale)
{
    if (ch < ' ' || ch > '~')
        return;

    uint8_t index = ch - ' ';

    for (uint8_t i = 0; i < 6; i++)
    {
        uint8_t line = font6x8[index][i];

        for (uint8_t j = 0; j < 8; j++)
        {
            uint8_t pixel_color;

            if (line & (1 << j))
                pixel_color = color;
            else
                pixel_color = !color;

            for (uint8_t sx = 0; sx < scale; sx++)
            {
                for (uint8_t sy = 0; sy < scale; sy++)
                {
                    ssd1306DrawPixel(
                        x + i * scale + sx,
                        y + j * scale + sy,
                        pixel_color
                    );
                }
            }
        }
    }
}

// 문자열 확대 함수
void ssd1306DrawStringScale(int16_t x, int16_t y,
                            const char *str,
                            uint8_t color,
                            uint8_t scale)
{
    while (*str)
    {
        ssd1306DrawCharScale(x, y, *str, color, scale);

        x += 6 * scale;
        str++;
    }
}

void ssd1306PrintfScale(int16_t x, int16_t y,
                        uint8_t color,
                        uint8_t scale,
                        const char *fmt, ...)
{
    char buf[64];

    va_list args;
    va_start(args, fmt);

    vsnprintf(buf, sizeof(buf), fmt, args);

    va_end(args);

    ssd1306DrawStringScale( x, y, buf, color, scale );
}


//---- 이모지 ----//
void ssd1306DrawBitmap(int16_t x, int16_t y,
                       const uint8_t *bitmap,
                       uint8_t width,
                       uint8_t height,
                       uint8_t color)
{
    uint16_t byte_width = (width + 7) / 8;

    for (uint8_t j = 0; j < height; j++)
    {
        for (uint8_t i = 0; i < width; i++)
        {
            uint8_t byte = bitmap[j * byte_width + (i / 8)];

            if (byte & (0x80 >> (i % 8)))
            {
                ssd1306DrawPixel(x + i, y + j, color);
            }
        }
    }
}

static const uint8_t weather_sun_40x40[] = {
    0x00,0x00,0x00,0x00,0x00, 0x00,0x00,0x00,0x00,0x00,
    0x00,0x00,0x00,0x00,0x00, 0x00,0x00,0x1C,0x00,0x00,
    0x00,0x00,0x1C,0x00,0x00, 0x00,0x00,0x1C,0x00,0x00,
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    0x00,0x00,0x00,0x00,0x00, 0x00,0x00,0x00,0x00,0x00
};
static const uint8_t weather_cloud_40x40[] = {
    0x00,0x00,0x00,0x00,0x00, 0x00,0x00,0x00,0x00,0x00,
    0x00,0x00,0x00,0x00,0x00, 0x00,0x00,0x00,0x00,0x00,
    0x00,0x00,0x00,0x00,0x00, 0x00,0x00,0x00,0x00,0x00,
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    0x00,0x00,0x00,0x00,0x00, 0x00,0x00,0x00,0x00,0x00
};
static const uint8_t weather_rain_40x40[] = {
    0x00,0x00,0x00,0x00,0x00, 0x00,0x00,0x00,0x00,0x00,
    0x00,0x00,0x00,0x00,0x00, 0x00,0x00,0x3F,0x00,0x00,
    0x00,0x00,0xFF,0xC0,0x00, 0x00,0x01,0xFF,0xE0,0x00,
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    0x00,0x00,0x00,0x00,0x00, 0x00,0x00,0x00,0x00,0x00
};

// 화면 한장 다받으면 출력
void ssd1306DrawFrame(const uint8_t *frame)
{
    memcpy(
        ssd1306_buffer,
        frame,
        SSD1306_WIDTH * SSD1306_HEIGHT / 8
    );
}

void ssd1306Video(void) {
    //badapple
    /*
    * 정확히 1024바이트 수신 완료
    */
    if (frame_ready) {
        frame_ready = 0;
        /*
        * UART DMA로 받은 프레임을
        * SSD1306 화면 버퍼로 복사
        */
        ssd1306DrawFrame(frame_buf);
        
        /*
        * OLED에 실제 출력
        */
        ssd1306Update();
        
        /*
        * Python에게
        * "이 프레임 출력 끝났음"
        * ACK 전송
        */
    uint8_t ack = 'A';
    HAL_UART_Transmit( &huart2, &ack,1, 100 );

    /*
    * 다음 프레임 1024바이트 DMA 수신 시작
    */
    HAL_UART_Receive_DMA( &huart2, frame_buf, FRAME_SIZE );
    }
}

extern int time;
int weather = 3;
int weather_x = 12;
int weather_y = 18;

// 기본화면
void ssd1306Default(void) {
    ds1302GetDateTime(&rtc_time);
    ssd1306Clear();
    ssd1306DrawRect(0, 0, SSD1306_WIDTH, SSD1306_HEIGHT, SSD1306_COLOR_WHITE);
    if (time < 5 ) {ssd1306DrawString(14, 3, "Team : DISMISSED", SSD1306_COLOR_WHITE);}
    else {
        ssd1306DrawString(12, 3, "SmartHome Project", SSD1306_COLOR_WHITE);
        if (time == 10) { time = 0;}
    }
    ssd1306DrawLine(0, 11, 126, 11, SSD1306_COLOR_WHITE);
    ssd1306Update();
}


void ssd1306Weather(void) {
    ds1302GetDateTime(&rtc_time);
    ssd1306Clear();
    ssd1306DrawRect(0, 0, SSD1306_WIDTH, SSD1306_HEIGHT, SSD1306_COLOR_WHITE);
    if (time < 5 ) {ssd1306DrawString(14, 3, "Team : DISMISSED", SSD1306_COLOR_WHITE);}
    else {
        ssd1306DrawString(12, 3, "SmartHome Project", SSD1306_COLOR_WHITE);
        if (time == 10) { time = 0;}
    }
    ssd1306DrawLine(0, 11, 126, 11, SSD1306_COLOR_WHITE);
    ssd1306PrintfScale( 72, 15, SSD1306_COLOR_WHITE, 2, "%.0fC", dht_data.temperature );
    ssd1306PrintfScale( 72, 31, SSD1306_COLOR_WHITE, 2, "%.0f%%", dht_data.humidity );
    ssd1306Printf(66, 50, SSD1306_COLOR_WHITE, "%.2d:%.2d:%.2d", rtc_time.hour, rtc_time.min, rtc_time.sec);
    if (adcGetWater() < 3)
    {
        ssd1306DrawBitmap(weather_x, weather_y, weather_sun_40x40,
                      40, 40, SSD1306_COLOR_WHITE);
    }
    else if (3<= adcGetWater() && adcGetWater() <= 5)
    {
        ssd1306DrawBitmap(weather_x, weather_y, weather_cloud_40x40,
                      40, 40, SSD1306_COLOR_WHITE);
    }
    else if (5 < adcGetWater())
    {
        ssd1306DrawBitmap(weather_x, weather_y, weather_rain_40x40,
                      40, 40, SSD1306_COLOR_WHITE);
    }
    ssd1306Update();
}

void ssd1306Warning(void) {
    if ((HAL_GetTick() % 1000) < 500) { 
        ssd1306Clear(); 
        ssd1306Update();
    }
    else {
        memset(ssd1306_buffer, 0xFF, sizeof(ssd1306_buffer));
        ssd1306Update();
    }
}


void ssd1306Show(uint8_t mod) {
    if (!is_fired) {
        ssd1306Warning();
    }
    else {
        switch (mod)
        {
            case 0 :
                ssd1306Default();
                break;
            
            case 1 :
                ssd1306Weather();
                break;

            case 2 :
                ssd1306Video();
                break;
        }
    }
}